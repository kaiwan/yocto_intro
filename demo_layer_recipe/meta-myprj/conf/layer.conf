## demo_layer_recipe/meta-myprj/conf/layer.conf
```bitbake
# We have a conf and classes directory, add to BBPATH
BBPATH .= ":${LAYERDIR}"

# We have recipes-* directories, add to BBFILES
BBFILES += "${LAYERDIR}/recipes-*/*/*.bb \
            ${LAYERDIR}/recipes-*/*/*.bbappend"

BBFILE_COLLECTIONS += "meta-myprj"
BBFILE_PATTERN_meta-myprj = "^${LAYERDIR}/"
BBFILE_PRIORITY_meta-myprj = "6"

LAYERDEPENDS_meta-myprj = "core"
LAYERSERIES_COMPAT_meta-myprj = "wrynose"
```
